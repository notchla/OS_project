## phase1/Kconfig
```kconfig
#
# For a description of the syntax of this configuration file,
# see Documentation/kbuild/kconfig-language.txt.
#
mainmenu "Print Configuration"

choice target
	bool "Target Architecture"
	default TARGET_UMPS

config TARGET_UMPS
	bool "uMPS2 Emulator"
	help
        Compile the example for the uMPS2 emulator

config TARGET_UARM
	bool "uARM Emulator"
	help
        Compile the example for the uARM emulator

endchoice
```
